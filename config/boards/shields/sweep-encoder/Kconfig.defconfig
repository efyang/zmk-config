## config/boards/shields/sweep-encoder/Kconfig.defconfig
```kconfig
if SHIELD_SWEEP_ENCODER_LEFT

config ZMK_KEYBOARD_NAME
	default "Ferris Wheel"

config ZMK_SPLIT_BLE_ROLE_CENTRAL
	default y

endif


if SHIELD_SWEEP_ENCODER_RIGHT

config ZMK_KEYBOARD_NAME
	default "Ferris Wheel R"

endif


if SHIELD_SWEEP_ENCODER_RIGHT || SHIELD_SWEEP_ENCODER_LEFT

config ZMK_SPLIT
	default y


endif
```

## config/boards/shields/sweep-encoder/Kconfig.shield
```kconfig
# Copyright (c) 2020 Pete Johanson
# SPDX-License-Identifier: MIT

config SHIELD_SWEEP_ENCODER_LEFT
	def_bool $(shields_list_contains,sweep-encoder_left)

config SHIELD_SWEEP_ENCODER_RIGHT
	def_bool $(shields_list_contains,sweep-encoder_right)
```

## config/boards/shields/sweep-encoder/boards/nrfmicro_13.conf
```kconfig
CONFIG_CLOCK_CONTROL_NRF_K32SRC_RC=n
CONFIG_CLOCK_CONTROL_NRF_K32SRC_RC_CALIBRATION=n
CONFIG_CLOCK_CONTROL_NRF_K32SRC_30PPM=y
```

## config/west.yml
```yaml
manifest:
  remotes:
    - name: zmkfirmware
      url-base: https://github.com/zmkfirmware
    - name: split-encoder
      url-base: https://github.com/stephen
  projects:
    - name: zmk
      remote: split-encoder
      revision: stephen/split-encoder
      import: app/west.yml
  self:
    path: config
```
